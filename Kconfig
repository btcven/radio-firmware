## Kconfig
```kconfig
# Copyright (C) 2020 Locha Inc

menu "Turpial - Radio Firmware Configuration"

config SLIP_LOCAL_ADDR
    string "SLIP link local address"
    default "fe80::dead:beef:cafe:babe"
    help
        Default SLIP link local address

rsource "sys/Kconfig"

endmenu
```

## sys/net/Kconfig
```kconfig
# Copyright (C) 2020 Locha Inc

menu "Network"

rsource "aodvv2/Kconfig"
rsource "rfc5444/Kconfig"
rsource "vaina/Kconfig"

endmenu
```

## sys/net/aodvv2/Kconfig
```kconfig
menuconfig KCONFIG_MODULE_AODVV2
    bool "AODVv2 Routing Protocol"
    depends on MODULE_AODVV2

if KCONFIG_MODULE_AODVV2

rsource "Kconfig.timers"

config AODVV2_BUFFER_MAX_ENTRIES
    int "Packet buffer size"
    default 16
    help
        This is the maximum number of entries in the AODVv2 buffered packets
        set.

config AODVV2_MCMSG_MAX_ENTRIES
    int "Multicast Message Set size"
    default 16
    help
        This is the maximum number of entries in the Multicast Message Set.

config AODVV2_RCS_MAX_ENTRIES
    int "Router Client Set size"
    default 2
    help
        This is the maximum number of entries in the Router Client Set.

config AODVV2_LRS_MAX_ENTRIES
    int "Local Route Set size"
    default 16
    help
        This is the maximum number of entries in the Local Rute Set.

config METRIC_HOP_COUNT_AODVV2_MAX
    int "Configure maximum value for Hop Count metric"
    default 255

endif
```

## sys/net/rfc5444/Kconfig
```kconfig
menuconfig KCONFIG_MODULE_RFC5444
    bool "RFC 5444"
    depends on MODULE_RFC5444

if KCONFIG_MODULE_RFC5444

config RFC5444_MSG_QUEUE_SIZE
    int "Thread message queue size"
    default 16
    help
        This is the message queue size for the RFC 5444 thread.

config RFC5444_PACKET_SIZE
    int "Packet maximum size"
    default 128
    help
        This is the maximum size for a RFC 5444 packet.

config RFC5444_ADDR_TLVS_SIZE
    int "Address/TLVs buffer size"
    default 1024
    help
        This is the buffer size for the RFC 5444 Address/TLVs buffer used by the
        writer.

config RFC5444_TARGET_NUMOF
    int "Targets"
    default 16
    help
        This is the maximum target count.

endif
```
